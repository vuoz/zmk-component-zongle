## boards/vuoz/zongle/Kconfig.defconfig
```kconfig
if BOARD_ZONGLE
choice ZMK_BOOTMODE_MAGIC_VALUE_BOOTLOADER_TYPE
    default ZMK_BOOTMODE_MAGIC_VALUE_BOOTLOADER_TYPE_ADAFRUIT_NRF52
endchoice
endif
```

## boards/vuoz/zongle/Kconfig.zongle
```kconfig
# SPDX-License-Identifier: Apache-2.0

config BOARD_ZONGLE
    select SOC_NRF52833_QIAA
    imply RETAINED_MEM
    imply RETENTION
    imply RETENTION_BOOT_MODE
```

## boards/vuoz/zongle/board.yml
```yaml
board:
  name: zongle
  vendor: vuoz
  socs:
    - name: nrf52833
  revision:
    format: major.minor.patch
    default: 0.5.0
    revisions:
      - name: 0.5.0
```

## boards/vuoz/zongle/zongle_0_5_0_defconfig
```kconfig
CONFIG_GPIO=y

CONFIG_CLOCK_CONTROL_NRF=y
CONFIG_CLOCK_CONTROL_NRF_K32SRC_RC=y

CONFIG_ZMK_USB=y
CONFIG_ZMK_BLE=y

CONFIG_SETTINGS=y
CONFIG_SETTINGS_NVS=y

CONFIG_MPU_ALLOW_FLASH_WRITE=y
CONFIG_NVS=y
CONFIG_SETTINGS_NVS=y
CONFIG_FLASH=y
CONFIG_FLASH_PAGE_LAYOUT=y
CONFIG_FLASH_MAP=y

CONFIG_ARM_MPU=y

CONFIG_USE_DT_CODE_PARTITION=y
CONFIG_BUILD_OUTPUT_UF2=y

CONFIG_BT_CTLR_TX_PWR_PLUS_8=y

CONFIG_USB_DEVICE_STACK=y
CONFIG_USB_HID_DEVICE=y
```
